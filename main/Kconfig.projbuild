## main/Kconfig.projbuild
```kconfig
menu "Application Configuration"
    menu "Control Sampling"
	config CONTROL_SAMPLING_FREQ
	    int "Control Samp Freq"
	    default 80
	    help
		Frequency of sampling for control.

	config TEMP_N_SAMPLES
	    int "Temp N Samples"
	    default 1
	    help
		Number of control samples per temperature measurement.

    	config TEMP_AVE_N_MEAS
	    int "Temp Ave N Meas"
	    default 10
	    help
		Number of temperature measurements used for averaging.

	config CONTROL_PWM_CLOCK_TICK_N_SAMPLES
	    int "PWM Clock Tick N Samples"
	    default 10
	    help
		Number of samples corresponding to one PWM clock tick.

	config CONTROL_PWM_CLOCK_PERIOD_N_TICKS
	    int "PWM Clock Period N Ticks"
	    default 128
	    help
		Number of PWM clock ticks corresponding to the PWM period.

	config CONTROLLER_SAMPLING_PERIOD_N_SAMPLES
	    int "Controller Sampling Period N Samples"
	    default 80
	    help
		Number of control samples corresponding to the controller sampling period.
    endmenu

    menu "I2C Master"
        config I2C_MASTER_SCL
            int "SCL GPIO Num"
            default 19
            help
                GPIO number for I2C Master clock line.

        config I2C_MASTER_SDA
            int "SDA GPIO Num"
            default 18
            help
                GPIO number for I2C Master data line.

        config I2C_MASTER_PORT_NUM
            int "Port Number"
            default 1
            help
                Port number for I2C Master device.

        config I2C_MASTER_FREQUENCY
            int "Master Frequency"
            default 100000
            help
                I2C Speed of Master device.
    endmenu

    config PWM_GPIO
	int "PWM GPIO"
	range 0 34
	default 21
	help
	    GPIO number for PWM output.

    config KILLSWITCH_GPIO
	int "Killswitch GPIO"
	range 0 34
	default 14
	help
	    GPIO number for killswitch.
endmenu
```
